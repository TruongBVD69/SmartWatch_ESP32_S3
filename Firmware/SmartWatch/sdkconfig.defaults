## Firmware/SmartWatch/sdkconfig.defaults
```kconfig
CONFIG_ESPTOOLPY_FLASHMODE_DIO=y
CONFIG_ESPTOOLPY_FLASHFREQ_80M=y
CONFIG_ESPTOOLPY_FLASHSIZE_32MB=y
CONFIG_ESP_DEFAULT_CPU_FREQ_MHZ_240=y
CONFIG_ESP_DEFAULT_CPU_FREQ_MHZ=240
CONFIG_SPIRAM=y
CONFIG_SPIRAM_MODE_OCT=y
CONFIG_SPIRAM_SPEED_80M=y
CONFIG_SPIRAM_USE_MALLOC=y
CONFIG_SPIRAM_MALLOC_RESERVE_INTERNAL=32768
CONFIG_PARTITION_TABLE_CUSTOM=y
CONFIG_PARTITION_TABLE_CUSTOM_FILENAME="partitions.csv"
CONFIG_ESP_COREDUMP_ENABLE_TO_FLASH=y
# CONFIG_ESP_COREDUMP_CHECK_BOOT is not set
CONFIG_ESP_TASK_WDT_EN=y
CONFIG_ESP_TASK_WDT_INIT=y
CONFIG_ESP_TASK_WDT_PANIC=y
CONFIG_ESP_TASK_WDT_TIMEOUT_S=8
CONFIG_LOG_DEFAULT_LEVEL_INFO=y
CONFIG_LOG_MAXIMUM_LEVEL_INFO=y
CONFIG_FATFS_LFN_HEAP=y
CONFIG_SPIFFS_PAGE_SIZE=512
CONFIG_BSP_LCD_RGB_BOUNCE_BUFFER_HEIGHT=40
CONFIG_LV_DEF_REFR_PERIOD=16
CONFIG_LV_USE_LOG=y
CONFIG_LV_LOG_LEVEL_INFO=y
CONFIG_LV_USE_SYSMON=y
CONFIG_LV_USE_PERF_MONITOR=y
CONFIG_LV_USE_PERF_MONITOR_LOG_MODE=y
CONFIG_LV_PERF_MONITOR_ALIGN_TOP_RIGHT=y
CONFIG_LV_FONT_MONTSERRAT_32=y
CONFIG_BSP_SPIFFS_PARTITION_LABEL="assets"
CONFIG_XPOWERS_CHIP_AXP2101=y
CONFIG_XPOWERS_ESP_IDF_NEW_API=y
CONFIG_FREERTOS_ISR_STACKSIZE=2096
```
